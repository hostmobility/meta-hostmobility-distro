## conf/layer.conf
```bitbake
# We have a conf and classes directory, append to BBPATH
BBPATH .= ":${LAYERDIR}"

# We have recipes-* directories, add to BBFILES
BBFILES += "${LAYERDIR}/recipes-*/*/*.bb ${LAYERDIR}/recipes-*/*/*.bbappend"

BBFILE_COLLECTIONS += "hostmobility-distro"
BBFILE_PATTERN_hostmobility-distro = "^${LAYERDIR}/"
BBFILE_PRIORITY_hostmobility-distro = "91"

LAYERDEPENDS_hostmobility-distro = " \
    core \
    angstrom-layer \
"
```

## recipes-images/images/sdimage-bootpart-mx4-t30.wks
```
# short-description: Create SD card image with a boot partition
# long-description: Creates a partitioned SD card image. Boot files
# are located in the first vfat partition.

part /boot --source bootimg-partition --ondisk mmcblk --fstype=vfat --label boot --active --align 4 --size 16
part --ondisk mmcblk --fstype=ext3 --align 4 --size 480k
part /config --ondisk mmcblk --fstype=vfat --label config --align 4 --size 32
part / --source rootfs --ondisk mmcblk --fstype=ext3 --label root --align 4

bootloader --ptable msdos
```
